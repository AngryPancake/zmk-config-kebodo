## boards/shields/kebodo/Kconfig.shield
```kconfig
# Copyright (c) 2020 The ZMK Contributors
# SPDX-License-Identifier: MIT

config SHIELD_JORNE_LEFT
    def_bool $(shields_list_contains,kebodo_left)

config SHIELD_JORNE_RIGHT
    def_bool $(shields_list_contains,kebodo_right)
```

## config/west.yml
```yaml
manifest:
  remotes:
    - name: zmkfirmware
      url-base: https://github.com/zmkfirmware
    - name: dhruvinsh
      url-base: https://github.com/dhruvinsh
    - name: urob
      url-base: https://github.com/urob
    - name: AngryPancake
      url-base: https://github.com/AngryPancake
  projects:
    # - name: zmk
    #   remote: AngryPancake
    #   revision: disable-usb-sof
    #   import: app/west.yml
    - name: zmk
      remote: zmkfirmware
      revision: main
      import: app/west.yml
    - name: zmk-tri-state
      remote: dhruvinsh
      revision: main
    - name: zmk-behavior-tda
      remote: AngryPancake
      revision: main
    - name: zmk-behavior-send-string
      remote: AngryPancake
      revision: main
  self:
    path: config
```
